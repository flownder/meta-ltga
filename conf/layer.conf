## conf/layer.conf
```bitbake
# We have a conf and classes directory, add to BBPATH
BBPATH .= ":${LAYERDIR}"

# We have recipes-* directories, add to BBFILES
BBFILES += "${LAYERDIR}/recipes-*/*/*.bb \
            ${LAYERDIR}/recipes-*/*/*.bbappend"

BBFILE_COLLECTIONS += "ltga"
BBFILE_PATTERN_ltga = "^${LAYERDIR}/"
BBFILE_PRIORITY_ltga = "6"
#LAYERVERSION_ltga = "4"
#LAYERSERIES_COMPAT_ltga = "sumo"
#LAYERDEPENDS_ltga = "ti arm" ??? оставить зависимость
```
